## c3-hci/main/Kconfig.projbuild
```kconfig
menu "c3-hci"
    config C3HCI_UART_BAUDRATE
        int "HCI UART baud rate"
        range 115200 2000000
        default 1000000
        help
            1000000 and 2000000 divide exactly on both the SC7731G (26 MHz)
            and the C3 (80 MHz); the frame side has no RTS/CTS.
endmenu
```
